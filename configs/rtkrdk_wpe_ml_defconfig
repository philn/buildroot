## configs/rtkrdk_wpe_ml_defconfig
```kconfig
BR2_arm=y
BR2_cortex_a15=y
BR2_ARM_FPU_NEON_VFPV4=y
BR2_ARM_INSTRUCTIONS_THUMB2=y
BR2_JLEVEL=3
BR2_CCACHE=y
BR2_OPTIMIZE_2=y
BR2_TOOLCHAIN_BUILDROOT_GLIBC=y
BR2_BINUTILS_VERSION_2_33_X=y
BR2_GCC_VERSION_9_X=y
BR2_TOOLCHAIN_BUILDROOT_CXX=y
BR2_TARGET_GENERIC_ROOT_PASSWD="root"
BR2_TARGET_GENERIC_GETTY_PORT="ttyS0"
BR2_ROOTFS_POST_IMAGE_SCRIPT="board/rtk/rtk.sh"
BR2_PACKAGE_GSTREAMER1_18=y
BR2_PACKAGE_BITSTREAM_VERA=y
BR2_PACKAGE_SDK_RDKVA_RTK=y
BR2_PACKAGE_CA_CERTIFICATES=y
BR2_PACKAGE_WPEFRAMEWORK=y
BR2_PACKAGE_WPEFRAMEWORK_BUILD_TYPE_DEBUG=y
BR2_PACKAGE_WPEFRAMEWORK_PERSISTENT_PATH="/tmp/data/rtk/root"
BR2_PACKAGE_WPEFRAMEWORK_VOLATILE_PATH="/tmp/data/rtk/tmp"
BR2_PACKAGE_WPEFRAMEWORK_DATA_PATH="/tmp/data/rtk/usr/share/WPEFramework"
BR2_PACKAGE_WPEFRAMEWORK_INSTALL_PATH="/tmp/data/rtk/usr/share/WPEFramework"
BR2_PACKAGE_WPEFRAMEWORK_SYSTEM_PATH="/tmp/data/rtk/usr/lib/wpeframework/plugins"
BR2_PACKAGE_WPEFRAMEWORK_PROXYSTUB_PATH="/tmp/data/rtk/usr/lib/wpeframework/proxystubs"
BR2_PACKAGE_WPEFRAMEWORK_MESSAGING=y
BR2_PACKAGE_WPEFRAMEWORK_DISABLE_LEGACY_CONFIG_GENERATOR=y
# BR2_PACKAGE_WPEFRAMEWORK_DISPLAYINFO is not set
BR2_PACKAGE_WPEFRAMEWORK_SECURE_SOCKET=y
BR2_PACKAGE_WIDEVINE_VERSION_16=y
BR2_PACKAGE_WPEFRAMEWORK_COMPOSITOR=y
BR2_PACKAGE_WPEFRAMEWORK_COMPOSITOR_RESOLUTION_1080P=y
BR2_PACKAGE_WPEFRAMEWORK_MESSENGER=y
BR2_PACKAGE_WPEFRAMEWORK_MONITOR=y
BR2_PACKAGE_WPEFRAMEWORK_REMOTECONTROL=y
BR2_PACKAGE_WPEFRAMEWORK_MESSAGECONTROL=y
BR2_PACKAGE_WPEFRAMEWORK_WEBKITBROWSER=y
BR2_PACKAGE_WPEFRAMEWORK_RESIDENTAPP=y
BR2_PACKAGE_WPEFRAMEWORK_WEBSERVER=y
BR2_PACKAGE_WPEWEBKIT2_38=y
BR2_PACKAGE_WPEWEBKIT_ENABLE_NATIVE_AUDIO=y
BR2_PACKAGE_WPEBACKEND_RDK_BACK_ESSOS=y
BR2_PACKAGE_LIBCURL=y
BR2_PACKAGE_LIBNL=y
BR2_PACKAGE_PROTOBUF=y
BR2_PACKAGE_DROPBEAR=y
BR2_PACKAGE_LIGHTTPD=y
BR2_PACKAGE_RDKSPLASHSCREEN=y
BR2_PACKAGE_RDKSPLASHSCREEN_OPERATOR="metrological"
```

## package/sdk-rdkva-rtk/Config.in
```kconfig
config BR2_PACKAGE_SDK_RDKVA_RTK
 	bool "sdk-rdkva-rtk"
 	depends on BR2_arm
 	select BR2_PACKAGE_HAS_LIBEGL
 	select BR2_PACKAGE_HAS_LIBGLES
 	select BR2_PACKAGE_HAS_PLAYREADY
	select BR2_PACKAGE_HAS_WAYLAND_EGL
 	help
 	  Pre-compiled binaries for a platform

if BR2_PACKAGE_SDK_RDKVA_RTK

config BR2_PACKAGE_PROVIDES_LIBEGL
 	default "sdk-rdkva-rtk"

config BR2_PACKAGE_PROVIDES_LIBGLES
 	default "sdk-rdkva-rtk"

config BR2_PACKAGE_PROVIDES_PLAYREADY
 	default "sdk-rdkva-rtk"

config BR2_PACKAGE_HAS_WAYLAND_EGL
	bool

endif
```
